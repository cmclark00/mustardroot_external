## package/mustardOS/audio/m8c/Config.in
```kconfig
config BR2_PACKAGE_M8C
	bool "m8c"
	help
	  m8c is a client for Dirtywave M8 tracker's headless mode
	  
	  https://github.com/laamaa/m8c.git
```

## package/mustardOS/emulators/advanced_drastic/Config.in
```kconfig
config BR2_PACKAGE_ADVANCED_DRASTIC
	bool "advanced_drastic"
	   select BR2_PACKAGE_DRASTIC_LAYOUT
	   select BR2_PACKAGE_SDL2_DRASTIC
	help
          Advanced Drastic
          Is a NDS emulateur for linux.

           https://github.com/trngaje/advanced_drastic
```

## package/mustardOS/emulators/advanced_drastic/drastic_layout/Config.in
```kconfig
config BR2_PACKAGE_DRASTIC_LAYOUT
	bool "drastic_layout"
	help
          layout for Advanced Drastic

           https://github.com/trngaje/drastic_layout
```

## package/mustardOS/gpu/mali-mp400-sunxi-driver/Config.in
```kconfig
comment "mali-mp400-sunxi-driver needs a Linux kernel 3.4 to be built"
	depends on BR2_MALI_MP400_SUNXI
	depends on !BR2_LINUX_KERNEL

config BR2_PACKAGE_MALI_MP400_SUNXI_DRIVER
	bool "mali-mp400-sunxi-driver"
	select BR2_TOOLCHAIN_OPTIONAL_LINARO_ARM
	depends on BR2_LINUX_KERNEL
	help
	  This package builds and installs the Linux kernel driver for
	  the Mali Utgard GPU on Allwinner platforms, compatible with
	  the legacy Linux kernel (3.4). Note that it should be
	  installed together with the corresponding userspace OpenGL
	  libraries, which are provided as binaries only at:
	  https://github.com/linux-sunxi/sunxi-mali-proprietary
```

## package/mustardOS/gpu/mali-mp400-sunxi/Config.in
```kconfig
config BR2_PACKAGE_MALI_MP400_SUNXI
	bool "mali-mp400-sunxi"
	depends on BR2_aarch64 || (BR2_ARM_EABIHF && BR2_arm)
	depends on BR2_TOOLCHAIN_USES_GLIBC
	depends on BR2_TOOLCHAIN_OPTIONAL_LINARO_ARM
	select BR2_PACKAGE_HAS_LIBEGL
	select BR2_PACKAGE_HAS_LIBGLES
        select BR2_PACKAGE_HAS_LIBMALI
	help
	  Install userspace Allwinner OpenGL libraries for Mali
	  Utgard GPUs.

	  https://github.com/linux-sunxi/sunxi-mali-proprietary

if BR2_PACKAGE_MALI_MP400_SUNXI

config BR2_PACKAGE_PROVIDES_LIBEGL
	default "mali-mp400-sunxi"

config BR2_PACKAGE_PROVIDES_LIBGLES
	default "mali-mp400-sunxi"

config BR2_PACKAGE_PROVIDES_LIBMALI
        default "mali-mp400-sunxi"

choice
	prompt "Version"
	default BR2_PACKAGE_MALI_MP400_SUNXI_R4P0
	help
	  Select the version of the userspace module.

config BR2_PACKAGE_MALI_MP400_SUNXI_R3P2
	bool "r3p2-01rel1"
config BR2_PACKAGE_MALI_MP400_SUNXI_R4P0
	bool "r4p0-00rel0"

endchoice

config BR2_PACKAGE_MALI_MP400_SUNXI_REVISION
	string
	default "r3p2-01rel1"	if BR2_PACKAGE_MALI_MP400_SUNXI_R3P2
	default "r4p0-00rel0"	if BR2_PACKAGE_MALI_MP400_SUNXI_R4P0
endif

comment "mali-mp400-sunxi needs an EABIhf glibc toolchain"
	depends on BR2_arm
	depends on !BR2_TOOLCHAIN_USES_GLIBC || !BR2_ARM_EABIHF
```
